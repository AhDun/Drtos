/*------------------------------------------------------------------------------------------------------------------------
 * 文件名称：Interrupt.c

 * 文件内容：中断配置

 * 文件版本：1.0.0

 * 文件作者：阿顿

 * 开发环境：STC8A8K64S4A12@22.1184MHz芯片 & Keil uVision 5 

 * 注    意：
------------------------------------------------------------------------------------------------------------------------*/
/*------------------------------------------------------------------------------------------------------------------------
                                                  加载头文件区
------------------------------------------------------------------------------------------------------------------------*/
#include "Inc_Basic.h"//基本库
#include "Interrupt.h"
/*------------------------------------------------------------------------------------------------------------------------
 * 函数名称：InterruptTp

 * 函数功能：设置中断优先级

 * 输入参数：Itype(类型)class(优先级)

 * 输出参数：无

 * 注    意：无
------------------------------------------------------------------------------------------------------------------------*/
void InterruptTp(u8 Itype,u8 class)
{
	 if(Itype < 8)
	 {
		switch(class)//优先级
		{
			case 0:IPH &= ~(0x01 << Itype);IP &= ~(0x01 << Itype);break;//0
			case 1:IPH &= ~(0x01 << Itype);IP |= (0x01 << Itype);break;//1
			case 2:IPH |= (0x01 << Itype);IP &= ~(0x01 << Itype);break;//2
			case 3:IPH |= (0x01 << Itype);IP |= (0x01 << Itype);break;//3  
		}	

	 }
	 else
	 {
		switch(class)//优先级
		{
			case 0:IP2H &= ~(0x01 << (Itype - 8));IP2 &= ~(0x01 << (Itype - 8));break;//0
			case 1:IP2H &= ~(0x01 << (Itype - 8));IP2 |= (0x01 << (Itype - 8));break;//1
			case 2:IP2H |= (0x01 << (Itype - 8));IP2 &= ~(0x01 << (Itype - 8));break;//2
			case 3:IP2H |= (0x01 << (Itype - 8));IP2 |= (0x01 << (Itype - 8));break; //3 
		}	

	 }
}
/*------------------------------------------------------------------------------------------------------------------------
                                                  END
------------------------------------------------------------------------------------------------------------------------*/
