/*********************************************************************************************************
* 文件名称：1602App.c
* 摘    要：1602字符串输出/1602字符输出
* 当前版本：1.0.0
* 作    者：麦特实验室
* 完成日期：
* 内    容：
* 注    意：
* 开发环境：STC8A8K64S4A12@22.1184MHz芯片 & Keil uVision 5                                                                 
**********************************************************************************************************
* 取代版本：
* 作    者：
* 完成日期：
* 修改内容：
* 修改文件：
*********************************************************************************************************/

#include"Basic.h"
#include"LCD1602.h"//1602底层驱动
#include"1602App.h"

void LED1602Init()
{
	D1602_Write_Cmd(0x38);//运行模式
	D1602_Write_Cmd(0x0C);//光标
	D1602_Write_Cmd(0x01);//清空显示屏
	D1602_Write_Cmd(0x06);//移位
	D1602_Write_Cmd(0x80);//位置
}
/********************************
函数名称:outs_1602
函数功能:1602字符串输出
输入参数:*sdata(字符串或数组)
输    入:
输出参数:
输    出:
********************************/
void outs_1602(const char *sdata) reentrant
{
	if(*sdata != '\a')
		LED1602Init();
	else
		sdata++;
	while(1)
	{
		if(*sdata == 0)//当数据为空
			break;
		else if(*sdata == '\f')//打开光标
			D1602_Write_Cmd(0x0F);//光标
		else if(*sdata == '\n')//换行
		{
			D1602_Write_Cmd(0x80+40);//换行
		}
		else
		{
			D1602_Write_Dat(*sdata);//发送数据到1602
			if(DP1602 == 16)
				D1602_Write_Cmd(0x80+40);//换行
		}
		sdata++;//数据指针加一
	}
}
/********************************
函数名称:outchar_1602
函数功能:1602字符输出
输入参数:sdata(字符)
输    入:
输出参数:
输    出:
********************************/
void outchar_1602(u8 sdata)
{
	if(sdata == '\a')
		LED1602Init();
	else if(sdata == '\n')//换行
	{
		D1602_Write_Cmd(0x80+40);//换行
	}
	else if(sdata == '\f')//打开光标
		D1602_Write_Cmd(0x0F);//光标
	else
	{
		D1602_Write_Dat(sdata);//发送数据到1602
		if(DP1602 == 16)
			D1602_Write_Cmd(0x80+40);//换行	
	}
}
/********************************
函数名称:outbin_1602
函数功能:1602字符输出
输入参数:sdata(字符)
输    入:
输出参数:
输    出:
********************************/
void outbin_1602(u8 sdata)
{
	u8 xdata OB_F0;
	if(DP1602 == 0)
		LED1602Init();
	for(OB_F0 = 0; OB_F0 < 8;OB_F0++)
	{
	 	 if(sdata & (0x80 >>OB_F0))
		 	outchar_1602('1');
		 else
		 	outchar_1602('0');	
	}
}
/********************************
函数名称:outnum_1602
函数功能:1602数字输出
输入参数:sdata(数字)
输    入:
输出参数:
输    出:
********************************/
void outnum_1602(u32 sdata)
{
	 if(DP1602 == 0)
		LED1602Init();
	 if((sdata / 10000000000) > 0)
	 	D1602_Write_Dat(sdata / 10000000000 + 48);//发送数据到1602

	 if((sdata % 10000000000 / 1000000000) > 0)
	 	D1602_Write_Dat(sdata % 10000000000 / 1000000000 + 48);//发送数据到1602

	 if((sdata % 1000000000 / 100000000) > 0)
	 	D1602_Write_Dat(sdata % 1000000000 / 100000000 + 48);//发送数据到1602

	 if((sdata % 100000000 / 10000000) > 0)
	 	D1602_Write_Dat(sdata % 100000000 / 10000000 + 48);//发送数据到1602

	 if((sdata % 10000000 / 1000000) > 0)
	 	D1602_Write_Dat(sdata % 10000000 / 1000000 + 48);//发送数据到1602

	 if((sdata % 1000000 / 100000) > 0)
	 	D1602_Write_Dat(sdata % 1000000 / 100000 + 48);//发送数据到1602

	 if((sdata % 100000 / 10000) > 0)
	 	D1602_Write_Dat(sdata % 100000 / 10000 + 48);//发送数据到1602

	 if((sdata % 10000 / 1000) > 0)
	 	D1602_Write_Dat(sdata % 10000 / 1000 + 48);//发送数据到1602

	 if((sdata % 1000 / 100) > 0)
	 	D1602_Write_Dat(sdata % 1000 / 100 + 48);//发送数据到1602

	 if((sdata % 100 / 10) > 0)
	 	D1602_Write_Dat(sdata % 100 / 10 + 48);//发送数据到1602

	 D1602_Write_Dat(sdata % 10+ 48);//发送数据到1602

}
/********************************
函数名称:cmd_1602
函数功能:1602命令
输入参数:CmdDat(命令数据)
输    入:
输出参数:
输    出:
********************************/
void cmd_1602(u8 CmdDat)
{
 	D1602_Write_Cmd(CmdDat);
}
/********************************
函数名称:cmd_1602
函数功能:1602定位
输入参数:x(x坐标)y(y坐标)
输    入:
输出参数:
输    出:
********************************/
void cxy_1602(u8 x, u8 y)
{
	x -= 1;
	if(y > 1)
		D1602_Write_Cmd(0x80 + 40 + x);//	
	else
		D1602_Write_Cmd(0x80 + x);//
	DP1602 = x;	 	
}
