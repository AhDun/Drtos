/*------------------------------------------------------------------------------------------------------------------------
 * 文件名称：System_Uart.c

 * 文件内容：系统串口

 * 文件版本：1.0.0

 * 文件作者：麦特实验室

 * 开发环境：STC8A8K64S4A12@22.1184MHz芯片 & Keil uVision 5 

 * 注    意：
------------------------------------------------------------------------------------------------------------------------*/
/*------------------------------------------------------------------------------------------------------------------------
                                                  加载头文件区
------------------------------------------------------------------------------------------------------------------------*/
#include "Inc_Basic.h"//基本库
#include "String_Lib.h"
#include "System_Task.h"
#include "System_Control.h"
#include "System_Uart.h"
/*------------------------------------------------------------------------------------------------------------------------
                                                  变量初始化区
------------------------------------------------------------------------------------------------------------------------*/
u8 xdata UART_DAT[UART_DAT_Max] = {NULL};//串口缓冲区
u8 xdata UART_XDAT_SP = NULL;//UART_DAT_SP指针
u8 xdata UART_SKL = NULL;
/*命令查询表*/
code u8 cmdd[] = {"\
OU 3 \
RST 1 \
ISP 2 \
OFT 7 \
PHI 11 \
OFW 12 \
OPW 13 \
OPT 14 \
QTS 15 \
QST 16 \
QRT 17 \
PPD 9 \
INFO 4 \
OPTU 5 \
OFTU 6 \
PIDL 8 \
PLOW 10 \
HELP 18\
"};
/*------------------------------------------------------------------------------------------------------------------------
 * 函数名称：Systme_UART_Handle

 * 函数功能：串口接收数据结束

 * 输入参数：无

 * 输出参数：无

 * 注    意：无
------------------------------------------------------------------------------------------------------------------------*/
void Systme_UART_Handle()
{
	TaskRemove(UARTDAEND_AID);//注销任务(串口接收完成)
	if(SComp("#SAU",&UART_DAT[NULL]))//#SAU命令判断
	{
		UARTCMD_SAU();//模式切换
	}
	else if(UART_SKL)
	{
		SUARTAppMain();//用户命令(串口内联程序入口)
	}
	else
	{
		UARTSystemCmd();//系统命令
	}
	for(UART_XDAT_SP = NULL;UART_XDAT_SP < UART_DAT_Max;UART_XDAT_SP++)//清除缓冲区
	{
		if(UART_DAT[UART_XDAT_SP] == NULL)
		{
			break;
		}
		UART_DAT[UART_XDAT_SP] = NULL;
	}
	UART_XDAT_SP = NULL;
}
/*------------------------------------------------------------------------------------------------------------------------
 * 函数名称：Systme_UART_Input

 * 函数功能：串口数据接收

 * 输入参数：无

 * 输出参数：无

 * 注    意：无
------------------------------------------------------------------------------------------------------------------------*/
void Systme_UART_Input()
{
	#ifdef EnableSerialPortDebugging
	if(UART_XDAT_SP == NULL)
	{
		TaskLoad(UARTDAEND_AID,Task_Time,Task_Class_H3,UART_TIMES,Systme_UART_Handle);//创建任务(串口接收完成)
	}
	else 
	{
		TaskInfo[UARTDAEND_AID].Pa1 = UART_TIMES;
	}
	if(UART_SKL)
	{
		AUARTAppMain();//串口外联程序入口
	}
	else 
	{
		if(SBUF < 9 || SBUF > 127 || UART_XDAT_SP >= UART_DAT_Max)//检查合法性
		{
			ES = NULL;
			UART_XDAT_SP = NULL;
			if(UART_XDAT_SP >= UART_DAT_Max)
			{
				Uart_Outs("输入的数据,超出接收范围\n");
			}
			else	
			{
				Uart_Outs("请注意,输入出现异常\n");
				Uart_Outs("即将重启系统\n");//显示提示
				Power_ISP();//重启并进入ISP
			}
		}
	}
	if(UART_XDAT_SP < UART_DAT_Max)
	{
		UART_DAT[UART_XDAT_SP++] = SBUF;//写入缓存数组中
	}
	#endif
}
/*------------------------------------------------------------------------------------------------------------------------
 * 函数名称：SUARTAppMain

 * 函数功能：

 * 输入参数：无

 * 输出参数：无

 * 注    意：空函数
------------------------------------------------------------------------------------------------------------------------*/
void SUARTAppMain(){}
/*------------------------------------------------------------------------------------------------------------------------
 * 函数名称：AUARTAppMain

 * 函数功能：

 * 输入参数：无

 * 输出参数：无

 * 注    意：空函数
------------------------------------------------------------------------------------------------------------------------*/
void AUARTAppMain(){}


/*------------------------------------------------------------------------------------------------------------------------
                                            以下是串口命令处理程序区
------------------------------------------------------------------------------------------------------------------------*/


/*------------------------------------------------------------------------------------------------------------------------
 * 函数名称：UARTSystemCmd

 * 函数功能：串口系统命令处理

 * 输入参数：无

 * 输出参数：无

 * 注    意：无
------------------------------------------------------------------------------------------------------------------------*/
void UARTSystemCmd()
{
	ScC_lookup(&UART_DAT[0],'(');//小写转换为大写，在"("处停止转换。
	switch(CMD_COMP(&cmdd[0] ,& UART_DAT[0]))
	{
		case 1:UARTCMD_RST();break;
		case 2:UARTCMD_ISP();break;
		case 3:UARTCMD_OUTUART1();break;
		case 4:UARTCMD_INFO();break;
		case 5:UARTCMD_OPENTU();break;
		case 6:UARTCMD_OFFTU();break;
		case 7:UARTCMD_OFFTASK();break;
		case 8:UARTCMD_POWERIDL();break;
		case 9:UARTCMD_POWERPD();break;
		case 10:UARTCMD_POWERLOW();break;
		case 11:UARTCMD_POWERHIGH();break;
		case 12:UARTCMD_OFFWDT();break;
		case 13:UARTCMD_OPENWDT();break;
		case 14:UARTCMD_OPENTASKAPP();break;
		case 15:UARTCMD_PQueryTask();break;
		case 16:UARTCMD_QuerySystemTime();break;
		case 17:UARTCMD_QueryRunTime();break;
		case 18:UARTCMD_Help(&cmdd[0]);break;
		default:UARTCMDError();break;
	}
}
/*------------------------------------------------------------------------------------------------------------------------
 * 函数名称：CMD_COMP

 * 函数功能：串口命令匹配

 * 输入参数：无

 * 输出参数：无

 * 注    意：无
------------------------------------------------------------------------------------------------------------------------*/
s16 CMD_COMP(const u8* a,const u8 *b)
{
	int i = 0, j = 0,ret = 0;
	char *b1 = 0;
	b1 = b;
	SLookups:
	b = b1;
	j = SLookup(a, *b);
	a += j;
	j = 0;
	while (1)
	{
		if (*a != *b)
		{
			if ((*a <= 64 || *b >= 123) && (*b <= 64 || *b >= 123))
				break;
			else if (*b <= 64 || *b >= 123)
				return -1;
			else if (*a <= 64 || *a >= 123)
				goto SLookups;
			else
				goto SLookups;
		}
		a++;
		b++;
		j++;
	}
	while (1)
	{
		a++;
		if (*a >= 49 && *a <= 57)
			ret = (ret * 10) + (*a - 48);
		else
			break;
	}
	return ret;
}
/*------------------------------------------------------------------------------------------------------------------------
 * 函数名称：UARTCMD_OUTUART1

 * 函数功能：OUTUART1命令处理

 * 输入参数：无

 * 输出参数：无

 * 注    意：无
------------------------------------------------------------------------------------------------------------------------*/
void UARTCMD_OUTUART1()
{
	u8 a;
	for(a = SLookup(&UART_DAT[0],'(') + 1;a < UART_DAT_Max;a++)
	 {
	  if(UART_DAT[a] == ')')
		{
			break;
		}
		else if(UART_DAT[a] == 0x5C && UART_DAT[a + 1] == 'n')
		{
		 	Uart_Outchar('\n');
			a += 2;
		}
		else 
		{
			Uart_Outchar(UART_DAT[a]);
		}
	 }
}
/*------------------------------------------------------------------------------------------------------------------------
 * 函数名称：UARTCMD_QueryRunTime

 * 函数功能：QueryRunTime命令处理

 * 输入参数：无

 * 输出参数：无

 * 注    意：无
------------------------------------------------------------------------------------------------------------------------*/
void UARTCMD_QueryRunTime()
{
	Uart_Outs("已连续运行: ");
	Uart_Outnum(((RUNTime / 1000) /86400));
	Uart_Outs("天 ");
	Uart_Outnum(((RUNTime / 1000) /3600) % 24);
	Uart_Outs("时 ");
	Uart_Outnum(((RUNTime / 1000) /60) % 60);
	Uart_Outs("分 ");
	Uart_Outnum((RUNTime / 1000) % 60);
	Uart_Outs("秒");
	Uart_Outchar('\n');
}
/*------------------------------------------------------------------------------------------------------------------------
 * 函数名称：UARTCMD_INFO

 * 函数功能：INFO命令处理

 * 输入参数：无

 * 输出参数：无

 * 注    意：无
------------------------------------------------------------------------------------------------------------------------*/
void UARTCMD_INFO()
{
	u8 i;
	Uart_Outs("系统版本:NerveRTOS ");
	Uart_Outchar(Systemv / 100 + 48);
	Uart_Outchar('.');
	Uart_Outchar(Systemv % 100 /10 + 48);
	Uart_Outchar('.');
	Uart_Outchar(Systemv % 10 + 48);
	Uart_Outchar('\n');
	Uart_Outs("系统内部版本:NerveRTOS ");
	Uart_Outchar(Systemv / 100 + 48);
	Uart_Outchar('.');
	Uart_Outchar(Systemv % 100 /10 + 48);
	Uart_Outs(".STC8A8K64S4A12@22.1184MHz\n");
	Uart_Outs("开发:麦特实验室\n");
	Uart_Outs("产品ID: ");
	for(i = 0; i < 7; i++)//计算并输出ID
		Uart_Outnum((*(char code *)(SystemSvP + i)) + (*(char idata *)(0xF1 + i)));
	Uart_Outchar('\n');
	Uart_Outs("设备ID: ");
	for(i = 0; i < 7; i++)//计算并输出ID
		Uart_Outnum((*(char idata *)(0xF1 + i)));
	Uart_Outchar('\n');
	Uart_Outs("系统状态:");
	i = (AQSP  * 100) / TaskQueueMax;
	if(i > 80){
		  Uart_Outs("很差");
	}
	else if(i > 60){
		  Uart_Outs("较差");
	}
	else if(i > 40){
		  Uart_Outs("还行");
	}
	else if(i > 20){
		  Uart_Outs("较好");
	}
	else
		Uart_Outs("很好");
	Uart_Outchar('\n');
	UARTCMD_QueryRunTime();
}
/*------------------------------------------------------------------------------------------------------------------------
 * 函数名称：UARTCMD_ISP

 * 函数功能：ISP命令处理

 * 输入参数：无

 * 输出参数：无

 * 注    意：无
------------------------------------------------------------------------------------------------------------------------*/
void UARTCMD_ISP()
{
	Uart_Outs("3秒后重启!\n");
	TaskLoad(ISP_AID,Task_Time,9,3000,Power_ISP);//创建任务
}
/*------------------------------------------------------------------------------------------------------------------------
 * 函数名称：UARTCMD_RST

 * 函数功能：RST命令处理

 * 输入参数：无

 * 输出参数：无

 * 注    意：无
------------------------------------------------------------------------------------------------------------------------*/
void UARTCMD_RST()
{
	Uart_Outs("即将重启!\n");
	Power_RST();
}
/*------------------------------------------------------------------------------------------------------------------------
 * 函数名称：UARTCMD_OPENTU

 * 函数功能：OPENTU命令处理

 * 输入参数：无

 * 输出参数：无

 * 注    意：无
------------------------------------------------------------------------------------------------------------------------*/
void UARTCMD_OPENTU()
{
	TaskLoad(MonitorOutUART_AID,Task_Time,1,500,MonitorOutUART);//创建任务
	Uart_Outs("已打开系统监视器!\n");
}
/*------------------------------------------------------------------------------------------------------------------------
 * 函数名称：UARTCMD_OFFTU

 * 函数功能：OFFTU命令处理

 * 输入参数：无

 * 输出参数：无

 * 注    意：无
------------------------------------------------------------------------------------------------------------------------*/
void UARTCMD_OFFTU()
{
	TaskRemove(MonitorOutUART_AID);
	Uart_Outs("已关闭系统监视器!\n");
}
/*------------------------------------------------------------------------------------------------------------------------
 * 函数名称：UARTCMDError

 * 函数功能：命令发生异常响应程序

 * 输入参数：无

 * 输出参数：无

 * 注    意：无
------------------------------------------------------------------------------------------------------------------------*/
void UARTCMDError()
{
	Uart_Outs("输入的系统命令不存在!\n");
}
/*------------------------------------------------------------------------------------------------------------------------
 * 函数名称：UARTCMD_OFFTASK

 * 函数功能：OFFTASK命令处理

 * 输入参数：无

 * 输出参数：无

 * 注    意：无
------------------------------------------------------------------------------------------------------------------------*/
void UARTCMD_OFFTASK()
{
	OffTask();
	Uart_Outs("已关闭任务系统!\n");
	Uart_Outs("串口等功能，无法运行!!\n");
	Uart_Outs("断电恢复!\n");
}
/*------------------------------------------------------------------------------------------------------------------------
 * 函数名称：UARTCMD_POWERIDL

 * 函数功能：POWERIDL命令处理

 * 输入参数：无

 * 输出参数：无

 * 注    意：无
------------------------------------------------------------------------------------------------------------------------*/
void UARTCMD_POWERIDL()
{
	Uart_Outs("即将进入空闲模式!\n");
	OFFWDT();///关闭看门狗
	Power_IDL();
	Uart_Outs("已从空闲模式恢复!\n");
	WDT_Init();///初始化看门狗
}
/*------------------------------------------------------------------------------------------------------------------------
 * 函数名称：UARTCMD_POWERPD

 * 函数功能：POWERPD命令处理

 * 输入参数：无

 * 输出参数：无

 * 注    意：无
------------------------------------------------------------------------------------------------------------------------*/
void UARTCMD_POWERPD()
{
	Uart_Outs("即将进入掉电模式!\n");
	OFFWDT();///关闭看门狗
	Power_PD();
	Uart_Outs("已从掉电模式恢复!\n");
	WDT_Init();///初始化看门狗
}
/*------------------------------------------------------------------------------------------------------------------------
 * 函数名称：UARTCMD_POWERLOW

 * 函数功能：POWERLOW命令处理

 * 输入参数：无

 * 输出参数：无

 * 注    意：无
------------------------------------------------------------------------------------------------------------------------*/
void UARTCMD_POWERLOW()
{
	Power_Low();
	Uart_Outs("已进入低功耗模式!\n");
}
/*------------------------------------------------------------------------------------------------------------------------
 * 函数名称：UARTCMD_POWERHIGH

 * 函数功能：POWERHIGH命令处理

 * 输入参数：无

 * 输出参数：无

 * 注    意：无
------------------------------------------------------------------------------------------------------------------------*/
void UARTCMD_POWERHIGH()
{
	Power_High();
	Uart_Outs("已进入高功耗模式!\n");
}
/*------------------------------------------------------------------------------------------------------------------------
 * 函数名称：UARTCMD_OFFWDT

 * 函数功能：OFFWDT命令处理

 * 输入参数：无

 * 输出参数：无

 * 注    意：无
------------------------------------------------------------------------------------------------------------------------*/
void UARTCMD_OFFWDT()
{
	OFFWDT();///关闭看门狗
	TaskRemove(RSTWDT_AID);//注销任务(看门狗系统)
	Uart_Outs("已关闭看门狗!\n");
}
/*------------------------------------------------------------------------------------------------------------------------
 * 函数名称：UARTCMD_OPENWDT

 * 函数功能：OPENWDT命令处理

 * 输入参数：无

 * 输出参数：无

 * 注    意：无
------------------------------------------------------------------------------------------------------------------------*/
void UARTCMD_OPENWDT()
{
	TaskLoad(RSTWDT_AID,Task_Time,Task_Class_L1,1500,RSTWDT);//创建任务(看门狗系统)
	WDT_Init();///初始化看门狗
	Uart_Outs("已开启看门狗!\n");
}
/*------------------------------------------------------------------------------------------------------------------------
 * 函数名称：UARTCMD_OPENTASKAPP

 * 函数功能：OPENTASKAPP命令处理

 * 输入参数：无

 * 输出参数：无

 * 注    意：无
------------------------------------------------------------------------------------------------------------------------*/
void UARTCMD_OPENTASKAPP()
{
	OpenTask(ASCII_DEC(&UART_DAT[SLookup(&UART_DAT[0],'(') + 1]));
	Uart_Outs("已启动应用:");
	Uart_Outnum(ASCII_DEC(&UART_DAT[SLookup(&UART_DAT[0],'(') + 1]));
	Uart_Outchar('\n');
}
/*------------------------------------------------------------------------------------------------------------------------
 * 函数名称：UARTCMD_SAU

 * 函数功能：SAU命令处理

 * 输入参数：无

 * 输出参数：无

 * 注    意：无
------------------------------------------------------------------------------------------------------------------------*/
void UARTCMD_SAU()
{
	UART_SKL = !UART_SKL;
	if(UART_SKL){
		Uart_Outs("用户串口模式\n");
	}
	else{
		Uart_Outs("系统串口模式\n");
	}
}
/*------------------------------------------------------------------------------------------------------------------------
 * 函数名称：UARTCMD_PQueryTask

 * 函数功能：PQueryTask命令处理

 * 输入参数：无

 * 输出参数：无

 * 注    意：无
------------------------------------------------------------------------------------------------------------------------*/
void UARTCMD_PQueryTask()
{
	u8 PQT_F0;
	Uart_Outs("TASK ID: ");
	for(PQT_F0 = 0;PQT_F0 < TaskMax ;PQT_F0++) 
	{
		if(TaskInfo[PQT_F0].Py0 > 0)
		{
			Uart_Outnum(PQT_F0);
			Uart_Outchar(',');
		}
	}
	Uart_Outchar('\n');
}
/*------------------------------------------------------------------------------------------------------------------------
 * 函数名称：UARTCMD_QuerySystemTime

 * 函数功能：QuerySystemTime命令处理

 * 输入参数：无

 * 输出参数：无

 * 注    意：无
------------------------------------------------------------------------------------------------------------------------*/
void UARTCMD_QuerySystemTime()
{
	Uart_Outs("SystemTime: ");
	Uart_Outnum(SystemTime);
	Uart_Outchar('\n');
}
/*------------------------------------------------------------------------------------------------------------------------
 * 函数名称：UARTCMD_Help

 * 函数功能：Help命令处理

 * 输入参数：无

 * 输出参数：无

 * 注    意：无
------------------------------------------------------------------------------------------------------------------------*/
void UARTCMD_Help(const u8 *a)
{
	u8 i = 0;
	Uart_Outs("UART CMD Help: \n-------------\n");
	while(1)
	{
	 	if(*a == 0)
		{
			break;
		}
		else if(*a >= 65 && *a <= 122)
		{
			OUT_UART1(*a);//将数据送入发送寄存器中，自动发送
			i = 0;
		}
		else if(*a >= 48 && *a <= 57 && i == 0)
		{
			 OUT_UART1(0x0D) ;//将数据送入发送寄存器中，自动发送
			 OUT_UART1(0x0A);//将数据送入发送寄存器中，自动发送
			 i = 1;
		} 	
		a++;//向后移动一位指针
	}
	Uart_Outs("-------------\n");
}
/*------------------------------------------------------------------------------------------------------------------------
 * 函数名称：MonitorOutUART

 * 函数功能：系统监视器

 * 输入参数：无

 * 输出参数：无

 * 注    意：无
------------------------------------------------------------------------------------------------------------------------*/
void MonitorOutUART()
{
	u16 R0 = 0,R1 = 0;
	Uart_Outs("系统状态:");
	Uart_Outs("系统负载:");
	R0 = (AQSP * 100) / TaskQueueMax;
	R0++;
	OUT_UART1(R0 / 100 + 48);
	OUT_UART1(R0 %100 / 10 + 48);
	OUT_UART1(R0 % 10 + 48);
	OUT_UART1('%');
	Uart_Outs("|任务占用量:");
	for(R0 = 0; R0 < TaskMax;R0++)
	{
		if(TaskInfo[R0].Type > 0 || TaskInfo[R0].Py1 > 0)
		{
			R1++;
		}
	}
	R0 = (R1 * 100) / TaskMax;
	OUT_UART1(R0 / 100 + 48);
	OUT_UART1(R0 %100 / 10 + 48);
	OUT_UART1(R0 % 10 + 48);
	OUT_UART1('%');
	Uart_Outs("|看门狗状态:");
	if(WDT_CONTR & 0x20)
	{
		Uart_Outs("开启");	
	}
	else
	{
		Uart_Outs("关闭");
	}
	Uart_Outs("|系统时间时间戳:");
  Uart_Outnum(RUNTime);
	Uart_Outs("\n");
}
/*------------------------------------------------------------------------------------------------------------------------
                                                  END
------------------------------------------------------------------------------------------------------------------------*/