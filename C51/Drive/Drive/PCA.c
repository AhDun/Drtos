/*********************************************************************************************************
* 文件名称：PCA.c
* 摘    要：PCA
* 当前版本：1.0.0
* 作    者：阿顿
* 完成日期：
* 内    容：
* 注    意：
* 开发环境：STC8A8K64S4A12@22.1184MHz芯片 & Keil uVision 5                                                                 
**********************************************************************************************************
* 取代版本：
* 作    者：
* 完成日期：
* 修改内容：
* 修改文件：
*********************************************************************************************************/

#include"Basic.h"
#include"PCA.h"

u8 xdata cnt = 0;//存储PCA计时溢出次数
u32 xdata Count0[4] = {0};//首数据
u32 xdata Count1[4] = {0};//次数据
u32 xdata length[4] = {0};//长度(us) 

/********************************
函数名称:PCAInit
函数功能:PCA计数器初始化
输入参数:
输    入:
输出参数:
输    出:
********************************/                         
void PCAInit()
{
    CCON = 0x00;
    CMOD = 0x09;//PCA时钟为系统时钟,使能PCA计时中断
    CL = 0x00;
    CH = 0x00;
    CR = 1;//启动PCA计时器
    EA = 1;
}
/********************************
函数名称:PCA0Init
函数功能:PCA0初始化
输入参数:
输    入:
输出参数:
输    出:
********************************/
void PCA0Init()//红外接收
{
	if(!CR)
		PCAInit();
	CCAPM0 = 0x11;//PCA模块0为16位捕获模式（下降沿捕获）
    CCAP0L = 0x00;
    CCAP0H = 0x00;	
}
/********************************
函数名称:PCA1Init
函数功能:PCA0初始化
输入参数:
输    入:
输出参数:
输    出:
********************************/
void PCA1Init()
{
	if(!CR)
		PCAInit();
	CCAPM1 = 0x49;//PCA模块1为16位软件定时模式
    CCAP1L = 0x9A;
    CCAP1H = 0xA9;	
}
/********************************
函数名称:PCA2Init
函数功能:PCA2初始化
输入参数:
输    入:
输出参数:
输    出:
********************************/
void PCA2Init()
{
 	if(!CR)
		PCAInit();
	CCAPM2 = 0x4D;//PCA模块1为16位高速输出模式
    CCAP2L = 0x9A;
    CCAP2H = 0xA9;
}
/********************************
函数名称:PCA3Init
函数功能:PCA3初始化
输入参数:
输    入:
输出参数:
输    出:
********************************/
void PCA3Init()
{
 	if(!CR)
		PCAInit();
	CCAPM3 = 0x42; //PCA 模块 3 为 PWM 工作模式
 	PCA_PWM3 = 0xC0; //PCA 模块 3 输出 10 位 PWM
 	CCAP3L = 0xFF; //PWM 占空比为 96.875%[(400H-20H)/400H]
 	CCAP3H = 0xFF; 
}
/********************************
函数名称:PCAInterrupt
函数功能:PCA中断响应
输入参数:
输    入:
输出参数:
输    出:
********************************/
void PCAInterrupt() interrupt 7
{
 	 if(CF)//PCA计数器中断响应
	 {
		cnt++;
		CF = 0;
		CCAP3H -= 1;
	 }
	 if(CCF0)//PCA0中断响应
	 {
        Count0[0] = Count1[0];//备份上一次的捕获值
        ((u8 *)&Count1[0])[3] = CCAP0L;
        ((u8 *)&Count1[0])[2] = CCAP0H;
        ((u8 *)&Count1[0])[1] = cnt;
        ((u8 *)&Count1[0])[0] = 0;
        length[0] = Count1[0] - Count0[0]; //length保存的即为捕获的脉冲宽度
		length[0] = (u32)(length[0] * 0.04521);//转换为us微秒
		CCF0 = 0;
	 } 
	 if(CCF1)//PCA1中断响应
	 {
		 Count0[1] = (CCAP1L | (CCAP1H << 8)) + 0xA99A;
		 CCAP1L = Count0[1] & 0xFF;
		 CCAP1H = (Count0[1]>> 8)& 0xFF;
		 CCF1 = 0;
	 }
	 if(CCF2)//PCA2中断响应
	 {
		 Count0[2] = (CCAP1L | (CCAP1H << 8)) + 0xA99A;
		 CCAP1L = Count0[2] & 0xFF;
		 CCAP1H = (Count0[2]>> 8)& 0xFF;
		 CCF2 = 0;
	 }
	 if(CCF3)//PCA3中断响应
	 {
		 CCF3 = 0;
	 }
}
